## Kconfig
```kconfig
config LINEA40_POINTING_CONTROLS
    bool "LiNEA40 runtime pointing controls"
    default y
    depends on ZMK_POINTING
```

## dts/bindings/behaviors/tererun,behavior-pointing-control.yaml
```yaml
description: LiNEA40 runtime pointing control

compatible: "tererun,behavior-pointing-control"

include: one_param.yaml
```

## dts/bindings/input_processors/tererun,input-processor-pointing-control.yaml
```yaml
description: LiNEA40 runtime pointing input processor

compatible: "tererun,input-processor-pointing-control"

include: ip_zero_param.yaml
```
